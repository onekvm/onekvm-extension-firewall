## oe-recipes/conf/layer.conf
```bitbake
BBPATH .= ":${LAYERDIR}"
BBFILES += "${LAYERDIR}/recipes-*/*/*.bb ${LAYERDIR}/recipes-*/*/*.bbappend"
BBFILE_COLLECTIONS += "onekvm-extension-firewall"
BBFILE_PATTERN_onekvm-extension-firewall := "^${LAYERDIR}/"
BBFILE_PRIORITY_onekvm-extension-firewall = "8"
LAYERDEPENDS_onekvm-extension-firewall = "core onekvm"
LAYERSERIES_COMPAT_onekvm-extension-firewall = "wrynose"
```
